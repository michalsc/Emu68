/dts-v1/;
/plugin/;

/ {
    fragment@0 {
        target-path = "/";
        __overlay__ {
            emu68 {
                z2ram: z2ram {
                    status = "okay";
                    size = <4>;
                };
            };
        };
    };

    __overrides__ {
        size = <&z2ram>,"size:0";
    };
};
