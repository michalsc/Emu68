/dts-v1/;
/plugin/;

/ {
    fragment@0 {
        target-path = "/";
        __overlay__ {
            emu68 {
                #address-cells = <1>;
                #size-cells = <1>;
                cma: cma@0 {
                    reg = <0 0x00400000>;
                };
            };
        };
    };

    __overrides__ {
        size = <&cma>,"reg:4";
    };
};
